
/*
 * Copyright (c) 2020 The ZMK Contributors
 *
 * SPDX-License-Identifier: MIT
 */

#include <behaviors.dtsi>
#include <dt-bindings/zmk/keys.h>
#include <dt-bindings/zmk/bt.h>
#include <dt-bindings/zmk/outputs.h>

#define NAV_L 1
#define OTH_L 2
#define NUM_L 3
#define SYM_L 4
#define MED_L 5
#define FUN_L 6

// Using layer taps on thumbs, having quick tap as well helps w/ repeating space/backspace
&lt { quick_tap_ms = <200>; };
/*       COLEMAK DH 34 KEY POSITIONS FOR MODS
 * ╭─────────────────────╮ ╭─────────────────────╮
 * │  0   1   2   3   4  │ │  5   6   7   8   9  │
 * │ 10  11  12  13  14  │ │ 15  16  17  18  19  │
 * │ 20  21  22  23  24  │ │ 25  26  27  28  29  │
 * ╰───────╮     30  31  │ │ 32  33      ╭───────╯
 *         ╰─────────────╯ ╰─────────────╯           
 *         │ COLEMAK DH 36 KEY POSITIONS?│
 *         │ 30  31  32  │ │ 33  34  35  │
 *         ╰─────────────╯ ╰─────────────╯           
 */
/ {
    behaviors {
        hm: homerow_mods {
            compatible = "zmk,behavior-hold-tap";
            label = "homerow mods";
            #binding-cells = <2>;
            tapping_term_ms = <200>;
            flavor = "tap-preferred";
            bindings = <&kp>, <&kp>;
        };
    };

        keymap {
                compatible = "zmk,keymap";
/ {

//             COLEMAK DH KEY POSITIONS
// ╭─────────────────────╮ ╭─────────────────────╮
// │  Q   W   F   P   B  │ │  J   L   U   Y   ;  │
// │  A   R   S   T   G  │ │  M   N   E   I   O  │
// │  Z   X   C   D   V  │ │  K   H   ,   .   /  │
// ╰───────╮ ESC BK_ TAB │ │ RET SPC DEL ╭───────╯
//         ╰─────────────╯ ╰─────────────╯
//         │ MED NAV OTH │ │ SYM NUM FUN │
//         ╰─────────────╯ ╰─────────────╯            
//            MIRYOKU HOMEROW + THUMBS    
// ╭─────────────────────╮ ╭─────────────────────╮
// │                     │ │                     │
// │ WIN ALT CTL SHF     │ │     SHF CTL ALT WIN │
// │                     │ │                     │
// ╰───────╮ ESC BK_ TAB │ │ RET SPC DEL ╭───────╯
//         ╰─────────────╯ ╰─────────────╯   
//         │ MED NAV OTH │ │ SYM NUM FUN │
//         ╰─────────────╯ ╰─────────────╯   
                default_layer {
                label = "Default";
                        bindings = <
   &kp Q &kp W &kp F &kp P &kp B                        &kp J &kp L &kp U &kp Y &kp SEMI
   &hm LGUI A &hm LALT R &hm LCTRL S &hm LSHFT T &kp G  &kp M &hm RSHFT N &hm RCTRL E &hm RALT I &hm RGUI O     
   &kp Z &kp X &kp C &kp D &kp V                        &kp K &kp H &kp COMMA &kp DOT &kp FSLH
   &lt 5 ESC &lt 1 BSPC &lt 2 TAB                       &lt 4 RET &lt SPACE 3 &lt 6 DEL
                        >;
                };

// ╭─────────────────────╮ ╭─────────────────────╮
// │                     │ │ RDO UND CUT CPY PST │
// │                     │ │ CAP ⬅   ⬇   ⬆  ⮕  │
// │                     │ │ INS HM  PGD PGU END │
// ╰───────╮             │ │ LWN     RWN ╭───────╯
//         ╰─────────────╯ ╰─────────────╯
//         │     NAV     │ │             │
//         ╰─────────────╯ ╰─────────────╯         
                nav_layer {
                label = "Navigation";
                        bindings = <
    &trans &trans &trans &trans &trans    &trans &trans &trans &trans &trans
    &trans &trans &trans &trans &trans    &trans &kp LARW &kp DARW &kp UARW &kp RARW
    &trans &trans &trans &trans &trans    &trans &kp HOME &kp PG_DN &kp PG_UP &kp END
                  &trans &trans &trans    &kp LC(LG(LEFT)) &none &kp LC(LG(RIGHT))
                        >; 
                };

// ╭─────────────────────╮ ╭─────────────────────╮
// │  {   &   *   (   }  │ │                     │
// │  :   $   %   ^   +  │ │                     │
// │  ~   !   @   #  "│" │ │                     │
// ╰───────╮  (   )   _  │ │             ╭───────╯
//         ╰─────────────╯ ╰─────────────╯     
//         │             │ │ SYM         │
//         ╰─────────────╯ ╰─────────────╯   
                sym_layer {
                label = "Symbol";
                    bindings = <
    &kp LBRC  &kp AMPS &kp STAR  &kp KP_LPAR &kp RBRC   &trans &trans &trans &trans &trans
    &kp COLON &kp DLLR &kp PRCNT &kp CARET   &kp PLUS   &trans &trans &trans &trans &trans
    &kp TILDE &kp EXCL &kp AT    &kp HASH    &kp PIPE   &trans &trans &trans &trans &trans
                     &kp KP_LPAR &kp KP_RPAR &kp UNDER  &trans &trans &trans
                    >;
                };

// ╭─────────────────────╮ ╭─────────────────────╮
// │  [   7   8   9   ]  │ │                     │
// │  ;   4   5   6   =  │ │                     │
// │  `   1   2   3   \  │ │                     │
// ╰───────╮  .   0   -  │ │             ╭───────╯
//         ╰─────────────╯ ╰─────────────╯   
//         │             │ │     NUM     │
//         ╰─────────────╯ ╰─────────────╯   
                num_layer {
                label = "Number";
                    bindings = <
    &kp LBKT  &kp N7  &kp N8 &kp N9 &kp RBKT    &trans &trans &trans &trans &trans    
    &kp SEMI  &kp N4  &kp N5 &kp N6 &kp EQUAL   &trans &trans &trans &trans &trans    
    &kp GRAVE &kp N1  &kp N2 &kp N3 &kp BSLH    &trans &trans &trans &trans &trans    
                   &kp DOT &kp N0 &kp MINUS     &trans &trans &trans    
                    >;
                };

// ╭─────────────────────╮ ╭─────────────────────╮
// │                     │ │     RST BLD     CLR │
// │                     │ │                 TOG │
// │                     │ │ CPW     BT0 BT1 BT2 │
// ╰───────╮             │ │             ╭───────╯
//         ╰─────────────╯ ╰─────────────╯   
//         │         OTH │ │             │
//         ╰─────────────╯ ╰─────────────╯    
                other_layer {
                label = "Other";
                    bindings = <
    &trans &trans &trans &trans &trans    &trans     &reset   &bootloader  &trans       &bt BT_CLR
    &trans &trans &trans &trans &trans    &trans     &trans   &trans       &trans       &out OUT_TOG
    &trans &trans &trans &trans &trans    &caps_word &trans   &bt BT_SEL 0 &bt BT_SEL 1 &bt BT_SEL 2 
                  &trans &trans &trans    &trans     &trans   &trans
                    >;
                };

// ╭─────────────────────╮ ╭─────────────────────╮
// │                     │ │                     │
// │                     │ │     PRV VL+ VL- NXT │
// │                     │ │                     │
// ╰───────╮             │ │ STP PAU MUT ╭───────╯
//         ╰─────────────╯ ╰─────────────╯   
//         │ MED         │ │             │
//         ╰─────────────╯ ╰─────────────╯   
                media_layer {
                label = "Media";
                    bindings = <
&trans	   &trans     &trans      &trans          &trans       &trans           &trans         &trans       &trans       &trans
&trans     &trans     &trans      &trans          &trans       &trans           &kp C_PREV     &kp C_VOL_DN &kp C_VOL_UP &kp C_NEXT
&trans     &trans     &trans      &trans          &trans       &trans           &trans         &trans       &trans       &trans
                      &trans      &trans          &trans       &kp C_STOP       &kp C_PLAY_PAUSE &kp C_MUTE
                    >;
                };

// ╭─────────────────────╮ ╭─────────────────────╮
// │ F12 F7  F8  F9  PSC │ │                     │
// │ F11 F4  F5  F6  SLK │ │                     │
// │ F10 F1  F2  F3  PBR │ │                     │
// ╰───────╮ APP SPC TAB │ │             ╭───────╯
//         ╰─────────────╯ ╰─────────────╯   
//         │             │ │         FUN │
//         ╰─────────────╯ ╰─────────────╯   
                fun_layer {
                label = "Fun";
                    bindings = <
    &kp F12     &kp F7     &kp F8      &kp F9     &kp PSCRN         &trans          &trans         &trans      &trans     &trans
    &kp F11     &kp F4     &kp F5      &kp F6     &kp SLCK          &trans          &trans         &trans      &trans     &trans
    &kp F10     &kp F1     &kp F2      &kp F3     &kp PAUSE_BREAK   &trans          &trans         &trans      &trans     &trans
                           &kp K_APP   &kp SPACE  &kp TAB           &trans          &trans         &trans
                    >;
                };
        };
};